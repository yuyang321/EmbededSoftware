#include "bsp.h"
#include "..\gos\glib.h"
#include "..\user\guser.h"
#include "gSensorAlg.h"

#define PRESSA_CHANNEL_NUM				3
/*
	PRESS 1: RP200,75bar,0~10V
	PRESS 2:3: 100bar,1.xx mv/bar
*/
typedef struct PRESSA_SENSOR_CALI_PARAM_S{
	uint16_t Ubase;		//such as 1.42mv,1.42*1000=1420
	uint32_t Kgas;		//such as 1.69mv/bar,1.69*1000=1690
	uint16_t Kamp;		//such as 21倍，21*100=2100
}PRESSA_SENSOR_CALI_PARAM_s;

//read form eeprom
//{44500,132740,33},
PRESSA_SENSOR_CALI_PARAM_s	pacaliparam[PRESSA_CHANNEL_NUM]=\
{\
	{1420,1700,2120},\
	{44500,142221,33},\
	{3120,1700,2120}\
};
//输出值放大100倍
static uint16_t gCalPreaVal(uint8_t pressnum,PRESSA_SENSOR_CALI_PARAM_s calval)
{
	uint16_t pressval;
	uint32_t tempa;
	tempa = ((uint32_t)ADChannelCurVal[pressnum])*ADC_UREF_VAL * 100 /calval.Kamp * 100 / 4096 *10;
	if(tempa < calval.Ubase)
		return 0;
	else
		pressval = (tempa-calval.Ubase)*100/calval.Kgas;
	return pressval;
}

#define DAC_AMP_DIG_10V			3760
uint16_t gCalFvCtrlWordFromPval(uint16_t pval)
{
	uint16_t ctrlword;
//	calval = pacaliparam[1];
//	ctrlword = ( ((uint32_t)pval) * calval.Kgas / 100 + calval.Ubase ) / 100 * calval.Kamp  / 100 * 4096  / 10 / ADC_UREF_VAL ; 
	ctrlword = pval * 3760 / 7000;
	return ctrlword;
}

void gCalPresaVal(SYS_PRESS_INFOR_s *pdata)
{
	uint8_t loop;
	if(!pdata)
		return;
	//Get Press Senor style A
	for(loop=0;loop<PRESSA_CHANNEL_NUM;loop++)
	{
			*((uint16_t *)pdata+loop) = gCalPreaVal(loop,pacaliparam[loop]);
	}
	
}

uint16_t gpidctrlalg(FLOW_CTRL_ALG_PARM_s *parm, int16_t curerror, int16_t lasterror, int16_t lasterrorsum)
{
	int16_t ctrlout;
	ctrlout = parm->p*curerror + parm->i*(lasterrorsum+curerror) + parm->d*(curerror - lasterror);
	if(ctrlout < 0)
	{
		ctrlout = 0;
	}
	else
	{
		if(ctrlout > DAC_AMP_DIG_10V)
			ctrlout = DAC_AMP_DIG_10V;
	}
	return(ctrlout);
}
/**
	CRC Calculate
**/
//CRC的高8位查找表
static const uint8_t s_CRCHi[] = {
    0x00, 0xC1, 0x81, 0x40, 0x01, 0xC0, 0x80, 0x41, 0x01, 0xC0,
    0x80, 0x41, 0x00, 0xC1, 0x81, 0x40, 0x01, 0xC0, 0x80, 0x41,
    0x00, 0xC1, 0x81, 0x40, 0x00, 0xC1, 0x81, 0x40, 0x01, 0xC0,
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    0x80, 0x41, 0x00, 0xC1, 0x81, 0x40
} ;
//CRC的低8位查找表
const uint8_t s_CRCLo[] = {
	0x00, 0xC0, 0xC1, 0x01, 0xC3, 0x03, 0x02, 0xC2, 0xC6, 0x06,
	0x07, 0xC7, 0x05, 0xC5, 0xC4, 0x04, 0xCC, 0x0C, 0x0D, 0xCD,
	0x0F, 0xCF, 0xCE, 0x0E, 0x0A, 0xCA, 0xCB, 0x0B, 0xC9, 0x09,
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	0x43, 0x83, 0x41, 0x81, 0x80, 0x40
};
/**
	CRC16返回值：CRCh << 8 | CRCl
**/
uint16_t CRC16_Modbus(uint8_t *_pBuf, uint16_t _usLen)
{
	uint8_t ucCRCHi = 0xFF; 
	uint8_t ucCRCLo = 0xFF; 
	uint16_t usIndex;
	while (_usLen--)
	{
	usIndex = ucCRCHi ^ *_pBuf++;
	ucCRCHi = ucCRCLo ^ s_CRCHi[usIndex];
	ucCRCLo = s_CRCLo[usIndex];
	}
	return ((uint16_t)ucCRCHi << 8 | ucCRCLo);
}


